/*
 * Copyright (c) 2018 BayLibre, SAS.
 * Author: Neil Armstrong <narmstrong@baylibre.com>
 *
 * SPDX-License-Identifier: (GPL-2.0+ OR MIT)
 */

/*
 * This overlay is designed to enable support for the Ilitek ILI9341 based panels.
 * The list includes various Adafruit displays, each with different sizes and features.
 * The pin connections for these displays are also specified.
 */

// Specifies that this is a Device Tree Source version 1 file.
/dts-v1/;

// Indicates that this file is a plugin overlay for the device tree.
/plugin/;

// Include necessary GPIO bindings for the device tree.
#include <dt-bindings/gpio/gpio.h>
#include <dt-bindings/gpio/meson-gxl-gpio.h>

/ {
        // Specifies the compatibility of this overlay with various devices.
        compatible = "libretech,cc", "amlogic,s905x", "amlogic,meson-gxl";

        fragment@0 {
                // Target the aliases node in the main device tree.
                target-path = "/aliases";

                __overlay__ {
                        // Define an alias for the SPI0 interface.
                        spi0 = "/soc/cbus@c1100000/spi@8d80";
                };
        };

        fragment@1 {
                // Target the SPI controller node in the main device tree.
                target = <&spicc>;

                __overlay__ {
                        /*
                         * Define the connections of the display signals to the board pins.
                         * This includes connections for data lines, control signals, power, and ground.
                         */
                        display@0 {
                                // Specifies that this device is compatible with the Ilitek ILI9341 driver.
                                compatible = "ilitek,ili9341";
                                // SPI chip select address.
                                reg = <0>;
                                // Display dimensions in pixels.
                                height = <320>;
                                width = <240>;
                                // Rotate the display by 180 degrees.
                                rotate = <180>;
                                // Width of the data bus in bits.
                                buswidth = <8>;
                                // Maximum SPI communication frequency.
                                spi-max-frequency = <30000000>;
                                // GPIO pin for controlling the display's backlight.
                                led-gpios = <&gpio GPIOX_0 GPIO_ACTIVE_HIGH>;
                                // GPIO pin for the Data/Command control signal.
                                dc-gpios = <&gpio GPIOX_17 GPIO_ACTIVE_HIGH>;
                                // GPIO pin for the display reset signal.
                                reset-gpios = <&gpio GPIOX_18 GPIO_ACTIVE_LOW>;
                                // Set the status of the display to "okay", indicating it's active and should be initialized.
                                status = "okay";
                        };
                };
        };
};